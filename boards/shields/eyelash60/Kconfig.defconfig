## boards/shields/eyelash60/Kconfig.defconfig
```kconfig
if SHIELD_EYELASH60_DONGLE

config ZMK_KEYBOARD_NAME
    default "Micro M"

config ZMK_SPLIT_ROLE_CENTRAL
    default y

endif

if SHIELD_EYELASH60_DONGLE || SHIELD_EYELASH60_PERIPHERAL

config ZMK_SPLIT
    default y

endif
```

## boards/shields/eyelash60/Kconfig.shield
```kconfig
config SHIELD_EYELASH60_DONGLE
    def_bool $(shields_list_contains,eyelash60_dongle)

config SHIELD_EYELASH60_PERIPHERAL
    def_bool $(shields_list_contains,eyelash60_peripheral)
```
